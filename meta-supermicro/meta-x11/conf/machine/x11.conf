## meta-supermicro/meta-x11/conf/machine/x11.conf
```bitbake
KMACHINE = "aspeed"
KERNEL_DEVICETREE = "${KMACHINE}-bmc-supermicro-${MACHINE}.dtb"
PREFERRED_PROVIDER_virtual/kernel = "linux-obmc"

require conf/machine/include/ast2400.inc
require conf/machine/include/obmc-bsp-common.inc
require conf/machine/include/supermicro.inc

UBOOT_MACHINE:x11 = "ast_g4_ncsi_config"
UBOOT_ENTRYPOINT = "0x40008000"
UBOOT_LOADADDRESS = "0x40008000"

FLASH_SIZE = "32768"

VIRTUAL-RUNTIME_skeleton_workbook = "supermicro-${MACHINE}-config"
PREFERRED_PROVIDER_virtual/obmc-inventory-data ?= "${VIRTUAL-RUNTIME_skeleton_workbook}"

PREFERRED_PROVIDER_virtual/phosphor-led-manager-config-native = "x11-led-manager-config-native"
```
