## meta-supermicro/meta-x11ssh/conf/machine/x11ssh.conf
```bitbake
KMACHINE = "aspeed"
KERNEL_DEVICETREE = "aspeed/aspeed-bmc-supermicro-x11ssh.dtb"

require conf/machine/include/ast2400.inc
require conf/machine/include/obmc-bsp-common.inc
require conf/machine/include/supermicro.inc

PREFERRED_PROVIDER_virtual/bootloader = "u-boot-aspeed"
PREFERRED_PROVIDER_u-boot = "u-boot-aspeed"
PREFERRED_PROVIDER_u-boot-fw-utils = "u-boot-fw-utils-aspeed"
UBOOT_MACHINE:x11ssh = "ast_g4_phy_defconfig"
UBOOT_DEVICETREE = "ast2400-evb"
UBOOT_ENTRYPOINT = "0x40008000"
UBOOT_LOADADDRESS = "0x40008000"

FLASH_SIZE = "32768"

VIRTUAL-RUNTIME_skeleton_workbook = "supermicro-${MACHINE}-config"

PREFERRED_PROVIDER_virtual/phosphor-led-manager-config-native = "x11ssh-led-manager-config-native"
```
